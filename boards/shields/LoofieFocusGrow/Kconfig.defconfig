## boards/shields/LoofieFocusGrow/Kconfig.defconfig
```kconfig
if LOOFIE_FOCUSGROW

config ZMK_KEYBOARD_NAME
    default "FocusGrow US" if LOOFIE_FOCUSGROW_US
    default "FocusGrow ISO" if LOOFIE_FOCUSGROW_ISO
    default "Loofie FocusGrow"

config SPI
    default y

endif

if LOOFIE_FOCUSGROW_NAPE_FG

config ZMK_KEYBOARD_NAME
    default "FocusGrowNP ISO" if LOOFIE_FOCUSGROW_NAPE_ISO
    default "FocusGrowNape"

config ZMK_USB
    default y

config BT_CENTRAL
    default y

config ZMK_SPLIT_ROLE_CENTRAL
    default y

endif

if LOOFIE_FOCUSGROW_NAPE_FG || LOOFIE_FOCUSGROW_NAPE_PERI

config SPI
    default y

config INPUT
    default y

config ZMK_POINTING
    default y

config ZMK_MOUSE
    default y

config ZMK_SPLIT
    default y

config ZMK_SPLIT_BLE
    default y

config ZMK_INPUT_SPLIT
    default y

endif
```

## boards/shields/LoofieFocusGrow/Kconfig.shield
```kconfig
config LOOFIE_FOCUSGROW
    def_bool $(shields_list_contains,LoofieFocusGrow)

config LOOFIE_FOCUSGROW_US
    def_bool $(shields_list_contains,LoofieFocusGrow_US)
    select LOOFIE_FOCUSGROW

config LOOFIE_FOCUSGROW_ISO
    def_bool $(shields_list_contains,LoofieFocusGrow_ISO)
    select LOOFIE_FOCUSGROW

config LOOFIE_FOCUSGROW_NAPE_FG
    def_bool $(shields_list_contains,LoofieFocusGrow_NapeFg)

config LOOFIE_FOCUSGROW_NAPE_ISO
    def_bool $(shields_list_contains,LoofieFocusGrow_NapeISO)
    select LOOFIE_FOCUSGROW_NAPE_FG

config LOOFIE_FOCUSGROW_NAPE_PERI
    def_bool $(shields_list_contains,LoofieFocusGrow_NapePeri)
```
